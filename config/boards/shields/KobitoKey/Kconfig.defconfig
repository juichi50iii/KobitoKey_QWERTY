## config/boards/shields/KobitoKey/Kconfig.defconfig
```kconfig
# ドングル設定（新規）
if SHIELD_KOBITOKEY_DONGLE_XIAO

config ZMK_KEYBOARD_NAME
    default "KobitoKey"

config ZMK_SPLIT_ROLE_CENTRAL
    default y

config ZMK_SPLIT
    default y

config ZMK_SPLIT_BLE_CENTRAL_PERIPHERALS
    default 2

config BT_MAX_CONN
    default 7

config BT_MAX_PAIRED
    default 7

config ZMK_POINTING
    default y

config SPI
    default y

endif

# 左（central）- ドングルなし構成用
if SHIELD_KOBITOKEY_LEFT
config ZMK_KEYBOARD_NAME
    default "KobitoKey"
endif

# 左右共通 - ドングルなし構成用
if SHIELD_KOBITOKEY_LEFT || SHIELD_KOBITOKEY_RIGHT
config ZMK_SPLIT
    default y
config ZMK_POINTING
    default y
config SPI
    default y
endif

# ペリフェラル専用シールド設定（新規）
if SHIELD_KOBITOKEY_LEFT_PERIPHERAL || SHIELD_KOBITOKEY_RIGHT_PERIPHERAL

config ZMK_SPLIT
    default y

config ZMK_SPLIT_ROLE_CENTRAL
    default n

config ZMK_POINTING
    default y

config SPI
    default y

endif
```

## config/boards/shields/KobitoKey/Kconfig.shield
```kconfig
# 既存シールド（ドングルなし構成用）
config SHIELD_KOBITOKEY_LEFT
    def_bool $(shields_list_contains,KobitoKey_left)

config SHIELD_KOBITOKEY_RIGHT
    def_bool $(shields_list_contains,KobitoKey_right)

# ドングル用ペリフェラルシールド（新規）
config SHIELD_KOBITOKEY_LEFT_PERIPHERAL
    def_bool $(shields_list_contains,KobitoKey_left_peripheral)

config SHIELD_KOBITOKEY_RIGHT_PERIPHERAL
    def_bool $(shields_list_contains,KobitoKey_right_peripheral)

# ドングルシールド（新規）
config SHIELD_KOBITOKEY_DONGLE_XIAO
    def_bool $(shields_list_contains,KobitoKey_dongle_xiao)
```

## config/west.yml
```yaml
manifest:
  remotes:
    - name: zmkfirmware
      url-base: https://github.com/zmkfirmware
    - name: badjeff
      url-base: https://github.com/badjeff
    - name: hsgw
      url-base: https://github.com/hsgw
    - name: caksoylar  # <-- led
      url-base: https://github.com/caksoylar  

  projects:
    # ZMK 本体。公式の app/west.yml を取り込む
    - name: zmk
      remote: zmkfirmware
      revision: ac7f75b8591d39aaf3b66b9d26f26c9ed921a009
      import: app/west.yml

    # PMW3610 ドライバ（外部モジュール）
    - name: zmk-pmw3610-driver
      remote: badjeff
      revision: zmk-0.3
      # 置き場所を明示したい場合は path を指定（任意）
      # path: modules/zmk-pmw3610-driver
    
    # Sensor-rotation
    - name: zmk-feature-sensor_rotation
      remote: hsgw
      revision: main

    # LED
    - name: zmk-rgbled-widget  # <-- led
      remote: caksoylar
      revision: main
      
  self:
    path: config
```
